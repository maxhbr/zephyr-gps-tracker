## app/west.yml
```yaml
manifest:
  defaults:
    remote: zephyrproject-rtos
  remotes:
    - name: zephyrproject-rtos
      url-base: https://github.com/zephyrproject-rtos
    - name: nrfconnect
      url-base: http://github.com/nrfconnect
    - name: u-blox
      url-base: http://github.com/u-blox
  projects:
    - name: zephyr
      remote: zephyrproject-rtos
      revision: main
      clone-depth: 1
      import: true
    - name: ubxlib
      remote: u-blox
      revision: v1.2.0
      clone-depth: 1
    # - name: nrf
    #   repo-path: sdk-nrf
    #   path: nrf
    #   remote: nrfconnect
    #   revision: v2.4.1
    #   import: true
  self:
    path: app
```
